## sdkconfig.defaults
```kconfig
# CalX ESP32 Firmware - Default SDK Configuration
# These settings are applied during project configuration

# ========================
# Flash and Partition
# ========================
CONFIG_ESPTOOLPY_FLASHSIZE_4MB=y
CONFIG_PARTITION_TABLE_CUSTOM=y
CONFIG_PARTITION_TABLE_CUSTOM_FILENAME="partitions.csv"

# ========================
# OTA Updates (Dual Partition)
# ========================
CONFIG_BOOTLOADER_APP_ROLLBACK_ENABLE=y

# ========================
# Wi-Fi
# ========================
CONFIG_ESP_WIFI_SOFTAP_SUPPORT=y
CONFIG_ESP_WIFI_NVS_ENABLED=y

# ========================
# HTTPS / TLS
# ========================
CONFIG_ESP_TLS_USING_MBEDTLS=y
CONFIG_MBEDTLS_SSL_MAX_CONTENT_LEN=16384
CONFIG_ESP_HTTP_CLIENT_ENABLE_HTTPS=y

# ========================
# NVS (Non-Volatile Storage)
# ========================
CONFIG_NVS_ENCRYPTION=n

# ========================
# FreeRTOS
# ========================
CONFIG_FREERTOS_HZ=1000
CONFIG_FREERTOS_USE_TICK_HOOK=n

# ========================
# Logging
# ========================
CONFIG_LOG_DEFAULT_LEVEL_INFO=y
CONFIG_LOG_MAXIMUM_LEVEL_DEBUG=y

# ========================
# Power Management
# ========================
CONFIG_PM_ENABLE=y
CONFIG_PM_DFS_INIT_AUTO=y

# ========================
# Watchdog
# ========================
CONFIG_ESP_TASK_WDT_EN=y
CONFIG_ESP_TASK_WDT_TIMEOUT_S=10

# ========================
# SNTP (Time Sync)
# ========================
CONFIG_LWIP_SNTP_MAX_SERVERS=3
```
